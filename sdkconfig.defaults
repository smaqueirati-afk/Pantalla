## sdkconfig.defaults
```kconfig
CONFIG_IDF_TARGET="esp32p4"
CONFIG_ESP32P4_SELECTS_REV_LESS_V3=y
CONFIG_ESP32P4_REV_MIN_1=y
CONFIG_ESPTOOLPY_FLASHMODE_QIO=y
CONFIG_ESPTOOLPY_FLASHSIZE_32MB=y
CONFIG_PARTITION_TABLE_CUSTOM=y
CONFIG_COMPILER_OPTIMIZATION_PERF=y
CONFIG_IDF_EXPERIMENTAL_FEATURES=y

# PSRAM HEX 200MHz - solo para datos/heap, NO XIP
CONFIG_SPIRAM=y
CONFIG_SPIRAM_MODE_HEX=y
CONFIG_SPIRAM_SPEED_200M=y
CONFIG_SPIRAM_USE_MALLOC=y
CONFIG_SPIRAM_BOOT_INIT=y
CONFIG_CACHE_L2_CACHE_256KB=y
CONFIG_CACHE_L2_CACHE_LINE_128B=y

CONFIG_ESP_MAIN_TASK_STACK_SIZE=10240
CONFIG_FREERTOS_HZ=1000

CONFIG_LV_FONT_MONTSERRAT_12=y
CONFIG_LV_FONT_MONTSERRAT_14=y
CONFIG_LV_FONT_MONTSERRAT_16=y
CONFIG_LV_FONT_MONTSERRAT_18=y
CONFIG_LV_FONT_MONTSERRAT_20=y
CONFIG_LV_FONT_MONTSERRAT_22=y
CONFIG_LV_FONT_MONTSERRAT_24=y
CONFIG_LV_FONT_MONTSERRAT_28=y
CONFIG_LV_ATTRIBUTE_FAST_MEM_USE_IRAM=y
CONFIG_LV_DRAW_SW_DRAW_UNIT_CNT=1
CONFIG_LV_DEF_REFR_PERIOD=15
CONFIG_LV_OS_FREERTOS=y
CONFIG_LV_USE_CLIB_MALLOC=y
CONFIG_LV_USE_CLIB_STRING=y
CONFIG_LV_USE_CLIB_SPRINTF=y

# CONFIG_ESP_HOST_WIFI_ENABLED removido - P4 no tiene WiFi propio
CONFIG_NVS_ASSERT_ERROR_CHECK=n
CONFIG_LV_MEM_BUF_MAX_NUM=32


CONFIG_LV_FONT_MONTSERRAT_48=y


CONFIG_LV_USE_CLIB_MALLOC=y

CONFIG_LV_MEM_SIZE=262144

CONFIG_LV_MEM_SIZE=262144

# ESP-Hosted + WiFi Remote (ESP32-C6 via SDIO)
CONFIG_ESP_WIFI_REMOTE_LIBRARY_HOSTED=y
CONFIG_ESP_HOSTED_SLAVE_ESP32C6=y
CONFIG_ESP_HOSTED_INTERFACE_SDIO=y
CONFIG_ESP_HOSTED_SDIO_CLK_GPIO=18
CONFIG_ESP_HOSTED_SDIO_CMD_GPIO=19
CONFIG_ESP_HOSTED_SDIO_D0_GPIO=14
CONFIG_ESP_HOSTED_SDIO_D1_GPIO=15
CONFIG_ESP_HOSTED_SDIO_D2_GPIO=16
CONFIG_ESP_HOSTED_SDIO_D3_GPIO=17
CONFIG_ESP_HOSTED_RESET_GPIO=54
CONFIG_ESP_HOSTED_SLAVE_RESET_GPIO=54

CONFIG_ESP_WIFI_SOFTAP_SUPPORT=y

CONFIG_ESP_WIFI_REMOTE_ENABLED=y

CONFIG_ESP_WIFI_REMOTE_LIBRARY_HOSTED=y
CONFIG_ESP_MAIN_TASK_STACK_SIZE=4096
CONFIG_ESP_MAIN_TASK_AFFINITY_CPU0=y

CONFIG_ESP_WIFI_IRAM_OPT=n

CONFIG_ESP_WIFI_RX_IRAM_OPT=n

CONFIG_ESP_HOSTED_SDIO_TX_Q_SIZE=5

CONFIG_ESP_HOSTED_SDIO_RX_Q_SIZE=5
CONFIG_LV_FONT_MONTSERRAT_10=y
```
